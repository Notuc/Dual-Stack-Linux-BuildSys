## br-external/Config.in
```kconfig
menu "Telemetry packages"
	source "$BR2_EXTERNAL_TELEMETRY_PATH/package/telemetry-daemon/Config.in"
	source "$BR2_EXTERNAL_TELEMETRY_PATH/package/logging-service/Config.in"
endmenu
```

## br-external/package/logging-service/Config.in
```kconfig
config BR2_PACKAGE_LOGGING_SERVICE
	bool "logging-service"
	depends on BR2_INSTALL_LIBSTDCPP
	help
	  Receives telemetry data over Unix socket and writes to disk.
```

## br-external/package/telemetry-daemon/Config.in
```kconfig
config BR2_PACKAGE_TELEMETRY_DAEMON
	bool "telemetry-daemon"
	depends on BR2_INSTALL_LIBSTDCPP
	help
	  CAN bus and BME280 telemetry daemon.
```
